## zmk/config/boards/shields/dusk36/Kconfig.defconfig
```kconfig
if SHIELD_DUSK36_LEFT

config ZMK_KEYBOARD_NAME
    default "Dusk-36"

config ZMK_SPLIT_BLE_ROLE_CENTRAL
    default y

endif

if SHIELD_DUSK36_RIGHT

config ZMK_KEYBOARD_NAME
	default "Dusk-36 Aux"

endif

if SHIELD_DUSK36_LEFT || SHIELD_DUSK36_RIGHT

config ZMK_SPLIT
    default y

endif
```

## zmk/config/boards/shields/dusk36/Kconfig.shield
```kconfig
config SHIELD_DUSK36_LEFT
	def_bool $(shields_list_contains,dusk36_left)

config SHIELD_DUSK36_RIGHT
	def_bool $(shields_list_contains,dusk36_right)
```
